## conf/layer.conf
```bitbake
# We have a conf and classes directory, add to BBPATH
BBPATH .= ":${LAYERDIR}"

# We have recipes-* directories, add to BBFILES
BBFILES += "${LAYERDIR}/recipes-*/*/*.bb \
            ${LAYERDIR}/recipes-*/*/*.bbappend"

BBFILE_COLLECTIONS += "meta-agl-reterminal"
BBFILE_PATTERN_meta-agl-reterminal = "^${LAYERDIR}/"
BBFILE_PRIORITY_meta-agl-reterminal = "71"

LAYERDEPENDS_meta-agl-reterminal = "core"
LAYERSERIES_COMPAT_meta-agl-reterminal = "kirkstone"
```
